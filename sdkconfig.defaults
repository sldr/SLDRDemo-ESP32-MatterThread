## sdkconfig.defaults
```kconfig
CONFIG_APP_PROJECT_VER_FROM_CONFIG=n

# Enable HKDF in mbedtls
CONFIG_MBEDTLS_HKDF_C=y

# Use a Project Config file
CONFIG_CHIP_PROJECT_CONFIG="SLDRDemoProjectConfig.h"

# Serial flasher config
CONFIG_ESPTOOLPY_FLASHSIZE_4MB=y

# Use a custom partition table
CONFIG_PARTITION_TABLE_CUSTOM=y
CONFIG_PARTITION_TABLE_FILENAME="partitions.csv"
CONFIG_PARTITION_TABLE_OFFSET=0xC000

# Button
CONFIG_BUTTON_PERIOD_TIME_MS=20
CONFIG_BUTTON_LONG_PRESS_TIME_MS=5000
```
